## config/boards/shields/scottoslant/Kconfig.defconfig
```kconfig
if SHIELD_SCOTTOSLANT

config ZMK_KEYBOARD_NAME
    default "ScottoSlant"

endif
```

## config/west.yml
```yaml
manifest:
  remotes:
    - name: zmkfirmware
      url-base: https://github.com/zmkfirmware
    - name: mousey
      url-base: https://github.com/ftc
  projects:
    - name: zmk
      remote: mousey
      revision: mouse-ftc
      import: app/west.yml
  self:
    path: config
```
